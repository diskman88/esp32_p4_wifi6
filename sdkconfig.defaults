## sdkconfig.defaults
```kconfig
#
# ESP Board Manager Configuration
#

#
# Peripheral Support
#
# CONFIG_ESP_BOARD_PERIPH_ADC_SUPPORT is not set
# CONFIG_ESP_BOARD_PERIPH_ANACMPR_SUPPORT is not set
# CONFIG_ESP_BOARD_PERIPH_DAC_SUPPORT is not set
CONFIG_ESP_BOARD_PERIPH_DSI_SUPPORT=y
CONFIG_ESP_BOARD_PERIPH_GPIO_SUPPORT=y
CONFIG_ESP_BOARD_PERIPH_I2C_SUPPORT=y
CONFIG_ESP_BOARD_PERIPH_I2S_SUPPORT=y
CONFIG_ESP_BOARD_PERIPH_LDO_SUPPORT=y
CONFIG_ESP_BOARD_PERIPH_LEDC_SUPPORT=y
CONFIG_ESP_BOARD_PERIPH_MCPWM_SUPPORT=y
CONFIG_ESP_BOARD_PERIPH_PCNT_SUPPORT=y
CONFIG_ESP_BOARD_PERIPH_RMT_SUPPORT=y
CONFIG_ESP_BOARD_PERIPH_SDM_SUPPORT=y
CONFIG_ESP_BOARD_PERIPH_SPI_SUPPORT=y
CONFIG_ESP_BOARD_PERIPH_UART_SUPPORT=y
# end of Peripheral Support

#
# Device Support
#
CONFIG_ESP_BOARD_DEV_AUDIO_CODEC_SUPPORT=y
# CONFIG_ESP_BOARD_DEV_BUTTON_SUPPORT is not set
CONFIG_ESP_BOARD_DEV_CAMERA_SUPPORT=y
CONFIG_ESP_BOARD_DEV_CAMERA_SUB_CSI_SUPPORT=y
# CONFIG_ESP_BOARD_DEV_CAMERA_SUB_DVP_SUPPORT is not set
# CONFIG_ESP_BOARD_DEV_CAMERA_SUB_SPI_SUPPORT is not set
CONFIG_ESP_BOARD_DEV_CUSTOM_SUPPORT=y
CONFIG_ESP_BOARD_DEV_DISPLAY_LCD_SUPPORT=y
CONFIG_ESP_BOARD_DEV_DISPLAY_LCD_SUB_DSI_SUPPORT=y
# CONFIG_ESP_BOARD_DEV_DISPLAY_LCD_SUB_PARLIO_SUPPORT is not set
# CONFIG_ESP_BOARD_DEV_DISPLAY_LCD_SUB_SPI_SUPPORT is not set
CONFIG_ESP_BOARD_DEV_FS_FAT_SUPPORT=y
CONFIG_ESP_BOARD_DEV_FS_FAT_SUB_SDMMC_SUPPORT=y
# CONFIG_ESP_BOARD_DEV_FS_FAT_SUB_SPI_SUPPORT is not set
# CONFIG_ESP_BOARD_DEV_FS_SPIFFS_SUPPORT is not set
CONFIG_ESP_BOARD_DEV_GPIO_CTRL_SUPPORT=y
# CONFIG_ESP_BOARD_DEV_GPIO_EXPANDER_SUPPORT is not set
CONFIG_ESP_BOARD_DEV_LCD_TOUCH_I2C_SUPPORT=y
CONFIG_ESP_BOARD_DEV_LEDC_CTRL_SUPPORT=y
CONFIG_ESP_BOARD_DEV_POWER_CTRL_SUPPORT=y
CONFIG_ESP_BOARD_DEV_POWER_CTRL_SUB_GPIO_SUPPORT=y
# end of Device Support
# end of ESP Board Manager Configuration

#
# Chip revision
# NOTE! Support of ESP32-P4 rev. <3.0 and >=3.0 is mutually exclusive
# Read the help text of the option below for explanation
#
CONFIG_ESP32P4_SELECTS_REV_LESS_V3=y
# CONFIG_ESP32P4_REV_MIN_0 is not set
# CONFIG_ESP32P4_REV_MIN_1 is not set
CONFIG_ESP32P4_REV_MIN_100=y
CONFIG_ESP32P4_REV_MIN_FULL=100
CONFIG_ESP_REV_MIN_FULL=100

# Maximum Supported ESP32-P4 Revision (Rev v1.99)
CONFIG_ESP32P4_REV_MAX_FULL=199
CONFIG_ESP_REV_MAX_FULL=199
CONFIG_ESP_EFUSE_BLOCK_REV_MIN_FULL=0
CONFIG_ESP_EFUSE_BLOCK_REV_MAX_FULL=199

# Maximum Supported ESP32-P4 eFuse Block Revision (eFuse Block Rev v0.99)
# end of Chip revision

CONFIG_ESPTOOLPY_FLASHSIZE_32MB=y
CONFIG_ESPTOOLPY_FLASHSIZE="32MB"

CONFIG_PARTITION_TABLE_CUSTOM=y
CONFIG_PARTITION_TABLE_CUSTOM_FILENAME="partitions.csv"

# Camera Sensor Configuration
CONFIG_CAMERA_OV5647=y
# PSRAM and Video Buffer Configuration
CONFIG_ESP_VIDEO_CSI_DEVICE_BUFFER_IN_PSRAM=y
CONFIG_SPIRAM_ALLOW_BSS_SEG_EXTERNAL_MEMORY=y
CONFIG_SPIRAM_USE_MALLOC_ALWAYS=y
CONFIG_CAMERA_OV5647_MIPI_RAW8_800x640_50FPS=y
# CONFIG_CAMERA_OV5647_MIPI_RAW8_800x800_50FPS is not set
```

## sdkconfig.defaults.esp32p4
```kconfig
CONFIG_IDF_TARGET="esp32p4"
CONFIG_IDF_TARGET_ESP32P4=y

CONFIG_SPIRAM=y
CONFIG_SPIRAM_MODE_HEX=y
CONFIG_SPIRAM_SPEED_200M=y
```
